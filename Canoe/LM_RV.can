/*@!Encoding:1252*/
includes
{
  
}

variables
{
  
}

on PDU Lichtmodul_Blinkersteuerung
{
  if($Lichtmodul_Blinkersteuerung_Blinkverhalten == 2)
  {
    @LM::bv_VR = $Lichtmodul_Blinkersteuerung_AnzahlLEDs;
  } 
  else if($Lichtmodul_Blinkersteuerung_Blinkverhalten == 3)
  {
    @LM::bv_VR = $Lichtmodul_Blinkersteuerung_AnzahlLEDs;
  }
  else
  {
    @LM::bv_VR = 0;
  }
}

on PDU Lichtmodul_Abbiegelicht
{
  if($Lichtmodul_Abbiegelicht_AbbiegelichtAN_AUS == 2)
  {
    @LM::ab_rechts = 1;
  }else
  {
    @LM::ab_rechts = 0;
  }
}