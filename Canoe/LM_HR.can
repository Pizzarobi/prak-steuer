/*@!Encoding:1252*/
includes
{
  
}

variables
{

}

on PDU Lichtmodul_Blinkersteuerung
{
   if($Lichtmodul_Blinkersteuerung_Blinkverhalten == 2)
  {
    @LM::bv_HR = $Lichtmodul_Blinkersteuerung_AnzahlLEDs;
  } 
  else if($Lichtmodul_Blinkersteuerung_Blinkverhalten == 3)
  {
    @LM::bv_HR = $Lichtmodul_Blinkersteuerung_AnzahlLEDs;
  }
  else
  {
    @LM::bv_HR = 0;
  }
}