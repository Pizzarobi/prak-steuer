/*@!Encoding:1252*/
includes
{
  
}

variables
{

}

on PDU Lichtmodul_Blinkersteuerung
{
  if($Lichtmodul_Blinkersteuerung_Blinkverhalten == 1)
  {
    @LM::bv_HL = $Lichtmodul_Blinkersteuerung_AnzahlLEDs;
  }
  else if($Lichtmodul_Blinkersteuerung_Blinkverhalten == 3)
  {
    @LM::bv_HL = $Lichtmodul_Blinkersteuerung_AnzahlLEDs;
  }
  else
  {
    @LM::bv_HL = 0;
  }
}
