AUTOSAR XML (schema 00044)
package /VectorAutosarExplorerGeneratedObjects/SYSTEM
  system System
package /VectorAutosarExplorerGeneratedObjects/FhrzCAN
  can cluster FhrzCAN: baudrate=500000, protocol-name=CAN, speed=250000
    can physical channel CANChannel
      comm-connectors:
        Connector_SZLS
        Connector_BSG
        Connector_SZMK
        Connector_ZSE
        Connector_LM_VL
        Connector_LM_HL
        Connector_LM_VR
        Connector_LM_HR
        Connector_LSM_49cb71687438ffe8
      frame StatusFahrlicht: id 0xA, from LSM, to ZSE, frame-length=1, can-addressing-mode=STANDARD, can-frame-tx-behavior=CAN-20
        pdu StatusFahrlicht_FahrlichtPDU: length=1
          signal StatusFahrlicht_FahrlichtPDU_FahrlichtAN_AUS: start 0, 8 bit, little-endian, system signal StatusFahrlicht_FahrlichtPDU_FahrlichtAN_AUS_3b299efe4f2e97ee, data-type-policy=OVERRIDE, base-type=New_BaseType, to ZSE
      frame Geschwindigkeit: id 0xB, from BSG, to ZSE, frame-length=2, can-addressing-mode=STANDARD, can-frame-tx-behavior=CAN-20
        pdu Geschwindigkeit_GesPDU: length=2
          signal Geschwindigkeit_GesPDU_Ges: start 0, 16 bit, little-endian, system signal Geschwindigkeit_GesPDU_Ges_465eee16e4ae4792, data-type-policy=OVERRIDE, base-type=New_BaseType, to ZSE
      frame StatusWarnblink: id 0x5, from SZMK, to ZSE, frame-length=1, can-addressing-mode=STANDARD, can-frame-tx-behavior=CAN-20
        pdu StatusWarnblink_WarnblinkPDU: length=1
          signal StatusWarnblink_WarnblinkPDU_WarnblinkAN_AUS: start 0, 8 bit, little-endian, system signal StatusWarnblink_WarnblinkPDU_WarnblinkAN_AUS_61a78d276e37c801, data-type-policy=OVERRIDE, base-type=New_BaseType, to ZSE
      frame Lichtmodul: id 0x7, from ZSE, to LM_VL LM_HL LM_HR LM_VR, frame-length=3, can-addressing-mode=STANDARD, can-frame-tx-behavior=CAN-20
        pdu Lichtmodul_Blinkersteuerung: length=2
          signal Lichtmodul_Blinkersteuerung_Blinkverhalten: start 0, 8 bit, little-endian, system signal Lichtmodul_Blinkersteuerung_Blinkverhalten_76ed67ef96dda27a, data-type-policy=OVERRIDE, base-type=New_BaseType, to LM_VL LM_HL LM_HR LM_VR
          signal Lichtmodul_Blinkersteuerung_AnzahlLEDs: start 8, 8 bit, little-endian, system signal Lichtmodul_Blinkersteuerung_AnzahlLEDs_c297726b312162ea, data-type-policy=OVERRIDE, base-type=New_BaseType, to LM_VL LM_HL LM_HR LM_VR
        carries pdu Lichtmodul_Abbiegelicht: packing-byte-order=little-endian, start-position=16
        pdu Lichtmodul_Abbiegelicht: length=1
          signal Lichtmodul_Abbiegelicht_AbbiegelichtAN_AUS: start 0, 8 bit, little-endian, system signal Lichtmodul_Abbiegelicht_AbbiegelichtAN_AUS_377794f7115fe062, data-type-policy=OVERRIDE, base-type=New_BaseType, to LM_VL LM_HL LM_HR LM_VR
      frame Lenksaeule: id 0x6, from SZLS, to ZSE, frame-length=3, can-addressing-mode=STANDARD, can-frame-tx-behavior=CAN-20
        pdu Lenksaeule_Lenkradwinkel: length=2
          signal Lenksaeule_Lenkradwinkel_Lenkradwinkel: start 0, 16 bit, little-endian, system signal Lenksaeule_Lenkradwinkel_Lenkradwinkel_92b19a7f962668cf, data-type-policy=OVERRIDE, base-type=New_BaseType, to ZSE
        carries pdu Lenksaeule_Hebelstellung: packing-byte-order=little-endian, start-position=16
        pdu Lenksaeule_Hebelstellung: length=1
          signal Lenksaeule_Hebelstellung_Hebelstellung: start 0, 8 bit, little-endian, system signal Lenksaeule_Hebelstellung_Hebelstellung_765327406b94115e, data-type-policy=OVERRIDE, base-type=New_BaseType, to ZSE
package /VectorAutosarExplorerGeneratedObjects/ECU_INSTANCES
  12 x ecu instance, all with diagnostic-address=0:
    SZLS: associated-com-i-pdu-group=[PduGroup_3bd542c2f7ef4cbdaa3c98b55715f094_Tx, PduGroup_265bfd0646644a619198d9220a740090_Tx, PduGroup_201d00344dcb4c83a80008c28e91ec98_Tx]
      can communication controller Controller_SZLS
      can communication connector Connector_SZLS: comm-controller=Controller_SZLS
    BSG: associated-com-i-pdu-group=PduGroup_2ef0443edc70426285f28a1be6e0ef0a_Tx
      can communication controller Controller_BSG
      can communication connector Connector_BSG: comm-controller=Controller_BSG
    SZMK: associated-com-i-pdu-group=PduGroup_f8c9f997eec04934b27131c62c43b841_Tx
      can communication controller Controller_SZMK
      can communication connector Connector_SZMK: comm-controller=Controller_SZMK
    LSM: associated-com-i-pdu-group=[PduGroup_0fcd52f9748549c9a1f7cd0fa6784170_Tx, PduGroup_dc8e0578b48941a88fce05efb6b0f451_Tx]
    ZSE: associated-com-i-pdu-group=[PduGroup_d4b0234ee0024a89b2b61f87a488e2df_Rx, PduGroup_cb5bd00b7b164041a51cdbd7022f2f1b_Rx, PduGroup_a88f5da223804bf48d5e3db554700f1d_Rx, PduGroup_6c169c0a2d0e40f98c7dcaa5ed985891_Rx, PduGroup_1554db3afe5d41be80f3c695a309478a_Rx, PduGroup_3fc3e43317a943178f2904d6ec4d17f0_Tx, PduGroup_239aff437aa6462f89ccad9476dfa287_Tx, PduGroup_3e39d0965e054b509c8f4a6dcbca5905_Rx, PduGroup_c1d118e10b2f4e3da061e2643ae63b9b_Rx, PduGroup_aaee771aaa8647c1a313560f1810b902_Rx, PduGroup_fd6860855d7f48c48f7c32f337871aca_Rx]
      can communication controller Controller_ZSE
      can communication connector Connector_ZSE: comm-controller=Controller_ZSE
    LM_VL: associated-com-i-pdu-group=[PduGroup_d8c5bdf71db64e2fb1016758b431d4ef_Rx, PduGroup_b1cba2a4911d41f88ba1fce02574339d_Rx]
      can communication controller Controller_LM_VL
      can communication connector Connector_LM_VL: comm-controller=Controller_LM_VL
    LM_HL
    LM_HL: associated-com-i-pdu-group=[PduGroup_b0cd393e31194178816121020afc7d33_Rx, PduGroup_005266ed8d41469a97fee095ebdf34c4_Rx]
      can communication controller Controller_LM_HL
      can communication connector Connector_LM_HL: comm-controller=Controller_LM_HL
    LM_VR: associated-com-i-pdu-group=[PduGroup_7e5ef4dfd24a48048b66274913faaee0_Rx, PduGroup_b54c6576efe44211aedcb9a48b0792e6_Rx]
      can communication controller Controller_LM_VR
      can communication connector Connector_LM_VR: comm-controller=Controller_LM_VR
    LM_HR: associated-com-i-pdu-group=[PduGroup_f29ce0c487d949dcaa71bf2ba98dacfa_Rx, PduGroup_3d6994324398407fb0502ac851a54d5a_Rx]
      can communication controller Controller_LM_HR
      can communication connector Connector_LM_HR: comm-controller=Controller_LM_HR
    New_ECU
    LSM: associated-com-i-pdu-group=[PduGroup_39f737b3fc064cfda7d1f7ff92834f8e_Tx, PduGroup_ed729f3a500c42d082dcb65a1a73fb31_Tx, PduGroup_8c1af54083f34089bac9d306de4aa993_Tx, PduGroup_83141b7e8dc442938b759a89774d55f5_Tx, PduGroup_8b3e0f599ab14d758b95b1fa795e6dbb_Tx]
      can communication controller Controller_LSM_30d058a910b69f1c
      can communication connector Connector_LSM_49cb71687438ffe8: comm-controller=Controller_LSM_30d058a910b69f1c
package /VectorAutosarExplorerGeneratedObjects/BASE_TYPES
  base type New_BaseType: base-type-size=0, base-type-encoding=2C
package /VectorAutosarExplorerGeneratedObjects/PDU_GROUP
  31 x i signal i pdu group:
    PduGroup_3bd542c2f7ef4cbdaa3c98b55715f094_Tx: communication-direction=OUT
    PduGroup_d4b0234ee0024a89b2b61f87a488e2df_Rx: communication-direction=IN
    PduGroup_2ef0443edc70426285f28a1be6e0ef0a_Tx: communication-direction=OUT
    PduGroup_cb5bd00b7b164041a51cdbd7022f2f1b_Rx: communication-direction=IN
    PduGroup_f8c9f997eec04934b27131c62c43b841_Tx: communication-direction=OUT
    PduGroup_a88f5da223804bf48d5e3db554700f1d_Rx: communication-direction=IN
    PduGroup_0fcd52f9748549c9a1f7cd0fa6784170_Tx: communication-direction=OUT
    PduGroup_6c169c0a2d0e40f98c7dcaa5ed985891_Rx: communication-direction=IN
    PduGroup_dc8e0578b48941a88fce05efb6b0f451_Tx: communication-direction=OUT
    PduGroup_1554db3afe5d41be80f3c695a309478a_Rx: communication-direction=IN
    PduGroup_3fc3e43317a943178f2904d6ec4d17f0_Tx: communication-direction=OUT
    PduGroup_d8c5bdf71db64e2fb1016758b431d4ef_Rx: communication-direction=IN
    PduGroup_b0cd393e31194178816121020afc7d33_Rx: communication-direction=IN
    PduGroup_f29ce0c487d949dcaa71bf2ba98dacfa_Rx: communication-direction=IN
    PduGroup_7e5ef4dfd24a48048b66274913faaee0_Rx: communication-direction=IN
    PduGroup_239aff437aa6462f89ccad9476dfa287_Tx: communication-direction=OUT
    PduGroup_b1cba2a4911d41f88ba1fce02574339d_Rx: communication-direction=IN
    PduGroup_005266ed8d41469a97fee095ebdf34c4_Rx: communication-direction=IN
    PduGroup_3d6994324398407fb0502ac851a54d5a_Rx: communication-direction=IN
    PduGroup_b54c6576efe44211aedcb9a48b0792e6_Rx: communication-direction=IN
    PduGroup_3e39d0965e054b509c8f4a6dcbca5905_Rx: communication-direction=IN
    PduGroup_c1d118e10b2f4e3da061e2643ae63b9b_Rx: communication-direction=IN
    PduGroup_39f737b3fc064cfda7d1f7ff92834f8e_Tx: communication-direction=OUT
    PduGroup_ed729f3a500c42d082dcb65a1a73fb31_Tx: communication-direction=OUT
    PduGroup_8c1af54083f34089bac9d306de4aa993_Tx: communication-direction=OUT
    PduGroup_aaee771aaa8647c1a313560f1810b902_Rx: communication-direction=IN
    PduGroup_83141b7e8dc442938b759a89774d55f5_Tx: communication-direction=OUT
    PduGroup_fd6860855d7f48c48f7c32f337871aca_Rx: communication-direction=IN
    PduGroup_265bfd0646644a619198d9220a740090_Tx: communication-direction=OUT
    PduGroup_201d00344dcb4c83a80008c28e91ec98_Tx: communication-direction=OUT
    PduGroup_8b3e0f599ab14d758b95b1fa795e6dbb_Tx: communication-direction=OUT
